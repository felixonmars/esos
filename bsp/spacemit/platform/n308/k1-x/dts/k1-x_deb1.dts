/*
 * Copyright (c) 2022-2025, Spacemit
 *
 * SPDX-License-Identifier: Apache-2.0
 */

/dts-v1/;

#include "k1-x.dtsi"
#include "k1-x-pinctrl.h"

&pmx_core {
        pinctrl-single,gpio-range = <
		&range GPIO_49  2 (MUX_MODE0 | EDGE_NONE | PULL_UP | PAD_3V_DS4)
	>;

	pinctrl_rcpu: pinctrl_rcpu_grp {
		pinctrl-single,pins = <
			K1X_PADCONF(GPIO_47, (MUX_MODE1 | EDGE_NONE | PULL_UP | PAD_3V_DS4))     /* r_uart0_tx */
			K1X_PADCONF(GPIO_48, (MUX_MODE1 | EDGE_NONE | PULL_UP | PAD_3V_DS4))     /* r_uart0_rx */
		>;
	};
};

&gpio {
	gpio-ranges = <&pmx_core 49  GPIO_49  2>;
};

&uart0 {
	pinctrl-names = "default";
	pinctrl-0 = <&pinctrl_rcpu>;
};
