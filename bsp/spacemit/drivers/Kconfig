## bsp/spacemit/drivers/Kconfig
```kconfig
menu "Hardware Drivers Config"

menu "Onboard Peripheral Drivers"

endmenu

menu "On-chip Peripheral Drivers"

    config BSP_USING_PIN
        bool "Enable PINTRL"
        select RT_USING_PIN
        default y

    config BSP_USING_GPIO
        bool "Enable GPIO"
        select RT_USING_GPIO
        default y

    config BSP_USING_UART
        bool "Enable UART"
        default y
        select RT_USING_SERIAL

    config BSP_USING_ADMA
        bool "Enable ADMA"
        default n

    config BSP_USING_DMA
        bool "Enable DMA"
        default n

    config BSP_USING_CAN
        bool "Enable CAN"
        default n
        select RT_USING_CAN
        select RT_CAN_USING_CANFD

    config BSP_USING_I2C
        bool "Enable I2C"
        default n

    config BSP_USING_WDT
        bool "Enable Watchdog"
        default n
        select RT_USING_WDT

    config BSP_USING_IR
        bool "Enable IR"
        default n

    config BSP_USING_PM
        bool "Enable PM"
        default n
        select RT_USING_PM

    config BSP_USING_PWM
        bool "Enable PWM"
        default n

    config BSP_USING_SPI
        bool "Enable SPI"
        default n

    config BSP_USING_HWTIMER
        bool "Enable HWtimer"
        default n
        select RT_USING_HWTIMER

    config BSP_USING_HWSPINLOCK
        bool "Enable hwspinlock"
        default n
        select RT_USING_HWSPINLOCK

    config BSP_USING_MAILBOX
        bool "Enable MAILBOX"
        default n
        select RT_USING_MAILBOX

    config BSP_USING_RPMSG
        bool "Enable rpmsg"
        default y
        select RT_USING_RPMSG_SERVICE

    config BSP_USING_REGULATOR
        bool "Enable regulator"
        default y
        select RT_USING_REGULATOR

    if BSP_USING_REGULATOR
       config BSP_REGULATOR_TEST
          bool "Enable regulator test driver"
          default n
    endif

    config BSP_USING_GMAC
        bool "Enable GMAC"
        default n

endmenu

menu "Board extended module Drivers"

endmenu

endmenu

menu "Platform Config"

choice
    prompt "select chip type"
    default SOC_SPACEMIT_K1_X

    config SOC_SPACEMIT_K1_X
    bool "SOC_SPACEMIT_K1_X"
        select RT_USING_COMPONENTS_INIT
        select RT_USING_USER_MAIN
        select ARCH_RISCV32
        select RT_USING_CACHE


    config SOC_SPACEMIT_K3
    bool "SOC_SPACEMIT_K3"
        select RT_USING_COMPONENTS_INIT
        select RT_USING_USER_MAIN
        select ARCH_RISCV64
        select ARCH_RISCV_FPU
        select ARCH_RISCV_FPU_D
        select RT_USING_CACHE

if SOC_SPACEMIT_K3
    choice
        prompt "select OS"
        default SOC_SPACEMIT_K3_CORE0

        config SOC_SPACEMIT_K3_CORE0
        bool "Energy OS"


        config SOC_SPACEMIT_K3_CORE1
        bool "Runtime OS"
    endchoice
endif
endchoice
endmenu
```

## esos.its
```
/dts-v1/;

/ {
	description = "ESOS dual-core image for K3";
	#address-cells = <2>;

	images {
		rcpu0-fw {
			description = "ESOS Core0";
			type = "standalone";
			os = "esos";
			arch = "riscv";
			compression = "none";
			load = <0x1 0x200000>;
			entry = <0x1 0x200000>;
			data = /incbin/("./bsp/spacemit/k3_os0_rcpu.elf");
			hash {
				algo = "crc32";
			};
		};

		rcpu1-fw {
			description = "ESOS Core1";
			type = "standalone";
			os = "esos";
			arch = "riscv";
			compression = "none";
			load = <0x1 0x804000>;
			entry = <0x1 0x804000>;
			data = /incbin/("./bsp/spacemit/k3_os1_rcpu.elf");
			hash {
				algo = "crc32";
			};
		};
	};

	configurations {
		default = "conf_dual";
		conf_dual {
			description = "ESOS Dual Core Configuration";
			loadables = "rcpu0-fw", "rcpu1-fw";
		};
	};
};
```

## esos_rt24.its
```
/dts-v1/;

/ {
	description = "ESOS dual-core image for K3";
	#address-cells = <2>;

	images {
		rcpu-data-null {
			description = "Using data interaction with AP";
			type = "standalone";
			os = "esos";
			arch = "riscv";
			compression = "lzo";
			load = <0x1 0xe04000>;
			entry = <0x1 0xe04000>;
			data = /incbin/("../output/esos/null.spacemit.lzo");
			hash {
				algo = "crc32";
			};
		};

		rcpu0-dtb-com260 {
			description = "ESOS Core0 Com260 dtb";
			type = "standalone";
			os = "esos";
			arch = "riscv";
			compression = "lzo";
			load = <0x1 0xe05000>;
			entry = <0x1 0xe05000>;
			data = /incbin/("../output/esos/k3_rt240_com260.dtb.lzo");
			hash {
				algo = "crc32";
			};
		};

		rcpu0-dtb-deb1 {
			description = "ESOS Core0 Deb1 dtb";
			type = "standalone";
			os = "esos";
			arch = "riscv";
			compression = "lzo";
			load = <0x1 0xe11800>;
			entry = <0x1 0xe11800>;
			data = /incbin/("../output/esos/k3_rt240_deb1.dtb.lzo");
			hash {
				algo = "crc32";
			};
		};

		rcpu0-dtb-evb {
			description = "ESOS Core0 Evb dtb";
			type = "standalone";
			os = "esos";
			arch = "riscv";
			compression = "lzo";
			load = <0x1 0xe1e000>;
			entry = <0x1 0xe1e000>;
			data = /incbin/("../output/esos/k3_rt240_evb.dtb.lzo");
			hash {
				algo = "crc32";
			};
		};

		rcpu0-dtb-evb2_1 {
			description = "ESOS Core0 Evb2_1 dtb";
			type = "standalone";
			os = "esos";
			arch = "riscv";
			compression = "lzo";
			load = <0x1 0xe2a800>;
			entry = <0x1 0xe2a800>;
			data = /incbin/("../output/esos/k3_rt240_evb2_1.dtb.lzo");
			hash {
				algo = "crc32";
			};
		};

		rcpu0-dtb-evb2_2 {
			description = "ESOS Core0 Evb2_2 dtb";
			type = "standalone";
			os = "esos";
			arch = "riscv";
			compression = "lzo";
			load = <0x1 0xe37000>;
			entry = <0x1 0xe37000>;
			data = /incbin/("../output/esos/k3_rt240_evb2_2.dtb.lzo");
			hash {
				algo = "crc32";
			};
		};

		rcpu1-dtb-com260 {
			description = "ESOS Core1 Com260 dtb";
			type = "standalone";
			os = "esos";
			arch = "riscv";
			compression = "lzo";
			load = <0x1 0xe43800>;
			entry = <0x1 0xe43800>;
			data = /incbin/("../output/esos/k3_rt241_com260.dtb.lzo");
			hash {
				algo = "crc32";
			};
		};

		rcpu1-dtb-deb1 {
			description = "ESOS Core1 Deb1 dtb";
			type = "standalone";
			os = "esos";
			arch = "riscv";
			compression = "lzo";
			load = <0x1 0xe50000>;
			entry = <0x1 0xe50000>;
			data = /incbin/("../output/esos/k3_rt241_deb1.dtb.lzo");
			hash {
				algo = "crc32";
			};
		};

		rcpu1-dtb-evb {
			description = "ESOS Core1 Evb dtb";
			type = "standalone";
			os = "esos";
			arch = "riscv";
			compression = "lzo";
			load = <0x1 0xe5c800>;
			entry = <0x1 0xe5c800>;
			data = /incbin/("../output/esos/k3_rt241_evb.dtb.lzo");
			hash {
				algo = "crc32";
			};
		};

		rcpu1-dtb-evb2_1 {
			description = "ESOS Core1 Evb2_1 dtb";
			type = "standalone";
			os = "esos";
			arch = "riscv";
			compression = "lzo";
			load = <0x1 0xe69000>;
			entry = <0x1 0xe69000>;
			data = /incbin/("../output/esos/k3_rt241_evb2_1.dtb.lzo");
			hash {
				algo = "crc32";
			};
		};

		rcpu1-dtb-evb2_2 {
			description = "ESOS Core1 Evb2_2 dtb";
			type = "standalone";
			os = "esos";
			arch = "riscv";
			compression = "lzo";
			load = <0x1 0xe75800>;
			entry = <0x1 0xe75800>;
			data = /incbin/("../output/esos/k3_rt241_evb2_2.dtb.lzo");
			hash {
				algo = "crc32";
			};
		};

		rcpu0-dtb-dc-board {
			description = "ESOS Core0 dc_board dtb";
			type = "standalone";
			os = "esos";
			arch = "riscv";
			compression = "lzo";
			load = <0x1 0xe82000>;
			entry = <0x1 0xe82000>;
			data = /incbin/("../output/esos/k3_rt240_dc_board.dtb.lzo");
			hash {
				algo = "crc32";
			};
		};

		rcpu1-dtb-dc-board {
			description = "ESOS Core1 dc_board dtb";
			type = "standalone";
			os = "esos";
			arch = "riscv";
			compression = "lzo";
			load = <0x1 0xe8e800>;
			entry = <0x1 0xe8e800>;
			data = /incbin/("../output/esos/k3_rt241_dc_board.dtb.lzo");
			hash {
				algo = "crc32";
			};
		};

		rcpu0-dtb-com260-kit-v02 {
			description = "ESOS Core0 com260_kit_v02 dtb";
			type = "standalone";
			os = "esos";
			arch = "riscv";
			compression = "lzo";
			load = <0x1 0xe9b000>;
			entry = <0x1 0xe9b000>;
			data = /incbin/("../output/esos/k3_rt240_com260_kit_v02.dtb.lzo");
			hash {
				algo = "crc32";
			};
		};

		rcpu1-dtb-com260-kit-v02 {
			description = "ESOS Core1 com260_kit_v02 dtb";
			type = "standalone";
			os = "esos";
			arch = "riscv";
			compression = "lzo";
			load = <0x1 0xea7800>;
			entry = <0x1 0xea7800>;
			data = /incbin/("../output/esos/k3_rt241_com260_kit_v02.dtb.lzo");
			hash {
				algo = "crc32";
			};
		};

		rcpu0-dtb-gemini-c0 {
			description = "ESOS Core0 gemini_c0 dtb";
			type = "standalone";
			os = "esos";
			arch = "riscv";
			compression = "lzo";
			load = <0x1 0xeb4000>;
			entry = <0x1 0xeb4000>;
			data = /incbin/("../output/esos/k3_rt240_gemini_c0.dtb.lzo");
			hash {
				algo = "crc32";
			};
		};

		rcpu1-dtb-gemini-c0 {
			description = "ESOS Core1 gemini_c1 dtb";
			type = "standalone";
			os = "esos";
			arch = "riscv";
			compression = "lzo";
			load = <0x1 0xec0800>;
			entry = <0x1 0xec0800>;
			data = /incbin/("../output/esos/k3_rt241_gemini_c0.dtb.lzo");
			hash {
				algo = "crc32";
			};
		};

		rcpu0-dtb-gemini-c1 {
			description = "ESOS Core0 gemini_c1 dtb";
			type = "standalone";
			os = "esos";
			arch = "riscv";
			compression = "lzo";
			load = <0x1 0xecd000>;
			entry = <0x1 0xecd000>;
			data = /incbin/("../output/esos/k3_rt240_gemini_c1.dtb.lzo");
			hash {
				algo = "crc32";
			};
		};

		rcpu1-dtb-gemini-c1 {
			description = "ESOS Core1 gemini_c1 dtb";
			type = "standalone";
			os = "esos";
			arch = "riscv";
			compression = "lzo";
			load = <0x1 0xed9800>;
			entry = <0x1 0xed9800>;
			data = /incbin/("../output/esos/k3_rt241_gemini_c1.dtb.lzo");
			hash {
				algo = "crc32";
			};
		};

		rcpu0-dtb-pico-itx {
			description = "ESOS Core0 Pico ITX dtb";
			type = "standalone";
			os = "esos";
			arch = "riscv";
			compression = "lzo";
			load = <0x1 0xee6000>;
			entry = <0x1 0xee6000>;
			data = /incbin/("../output/esos/k3_rt240_pico_itx.dtb.lzo");
			hash {
				algo = "crc32";
			};
		};

		rcpu1-dtb-pico-itx {
			description = "ESOS Core1 Pico ITX dtb";
			type = "standalone";
			os = "esos";
			arch = "riscv";
			compression = "lzo";
			load = <0x1 0xef2800>;
			entry = <0x1 0xef2800>;
			data = /incbin/("../output/esos/k3_rt241_pico_itx.dtb.lzo");
			hash {
				algo = "crc32";
			};
		};

		rcpu0-dtb-BS01DCMA {
			description = "ESOS Core0 BS01DCMA dtb";
			type = "standalone";
			os = "esos";
			arch = "riscv";
			compression = "none";
			load = <0x1 0xeff000>;
			entry = <0x1 0xeff000>;
			data = /incbin/("../output/esos/k3_rt240_BS01DCMA.dtb");
			hash {
				algo = "crc32";
			};
		};

		rcpu1-dtb-BS01DCMA {
			description = "ESOS Core1 BS01DCMA dtb";
			type = "standalone";
			os = "esos";
			arch = "riscv";
			compression = "none";
			load = <0x1 0xf0b800>;
			entry = <0x1 0xf0b800>;
			data = /incbin/("../output/esos/k3_rt241_BS01DCMA.dtb");
			hash {
				algo = "crc32";
			};
		};

		rcpu0-fw {
			description = "ESOS Core0";
			type = "standalone";
			os = "esos";
			arch = "riscv";
			compression = "lzo";
			load = <0x1 0x200000>;
			entry = <0x1 0x200000>;
			data = /incbin/("../output/esos/rt24_os0_rcpu.elf.lzo");
			hash {
				algo = "crc32";
			};
		};

		rcpu1-fw {
			description = "ESOS Core1";
			type = "standalone";
			os = "esos";
			arch = "riscv";
			compression = "lzo";
			load = <0x1 0x804000>;
			entry = <0x1 0x804000>;
			data = /incbin/("../output/esos/rt24_os1_rcpu.elf.lzo");
			hash {
				algo = "crc32";
			};
		};

	};

	configurations {
		default = "conf_dual";
		conf_dual {
			description = "ESOS Dual Core Configuration";
			loadables = "rcpu-data-null", "rcpu0-dtb-com260", "rcpu0-dtb-deb1", "rcpu0-dtb-evb", "rcpu0-dtb-evb2_1", "rcpu0-dtb-evb2_2", "rcpu1-dtb-com260", "rcpu1-dtb-deb1",
			"rcpu1-dtb-evb", "rcpu1-dtb-evb2_1", "rcpu1-dtb-evb2_2", "rcpu0-dtb-dc-board", "rcpu1-dtb-dc-board", "rcpu0-dtb-com260-kit-v02", "rcpu1-dtb-com260-kit-v02",
			"rcpu0-dtb-gemini-c0", "rcpu1-dtb-gemini-c0", "rcpu0-dtb-gemini-c1", "rcpu1-dtb-gemini-c1", "rcpu0-dtb-pico-itx", "rcpu1-dtb-pico-itx",
			"rcpu0-dtb-BS01DCMA", "rcpu1-dtb-BS01DCMA", "rcpu0-fw", "rcpu1-fw";
		};
	};
};
```
